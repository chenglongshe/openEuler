## Documentation/devicetree/bindings/gpio/phytium,sgpio.yaml
```yaml
# SPDX-License-Identifier: (GPL-2.0-only OR BSD-2-Clause)
%YAML 1.2
---
$id: http://devicetree.org/schemas/gpio/phytium,sgpio.yaml#
$schema: http://devicetree.org/meta-schemas/core.yaml#

title: Phytium SGPIO Controller

description: |
  This SGPIO controller is for Phytium E2000 SoC, which supports up to
  96 (32x3) Serial GPIOs.

maintainers:
  - Chen Baozi <chenbaozi@phytium.com.cn>

properties:
  $nodename:
    pattern: "^sgpio@[0-9a-f]+$"

  compatible:
    const: phytium,sgpio

  reg:
    minItems: 1

  interrupts:
    description: |
      Interrupt mapping for GPIO IRQ.
  
  gpio-controller:
    description: |
      Marks the device node as a gpio controller.

  '#gpio-cells':
    const: 2

  ngpios:
    description: |
      number of GPIO lines, see gpio.txt
      (should be multiple of 32, up to 96 pins)

  bus-frequency:
    description: |
      SGPIO CLK frequency

  clocks:
    description: |
      A phandle to the APB clock for SGPIO clock division

examples:
  - |

    sgpio: sgpio@2807d000 {
        compatible = "phytium,sgpio";
	reg = <0x0 0x2807d000 0x0 0x1000>;
	interrupts = <GIC_SPI 190 IRQ_TYPE_LEVEL_HIGH>;
	clocks = <&sysclk_48mhz>;
	ngpios = <96>;
	bus-frequency = <48000>;
	gpio-controller;
	#gpio-cells = <2>;
    };
```

## drivers/PriChain_codes/rb_mutex/Kconfig
```kconfig
config RB_MUTEX
	tristate "RB Mutex Support"
	depends on MODULES
	help
	  This enables support for RB Mutex, a custom mutex implementation
	  that can be used as an alternative to rt_mutex.
	  
	  If you want to compile it as a module, say M here.
	  If you want to compile it into the kernel, say Y here.
	  If you don't want to compile it, say N here.
	  
	  If unsure, say N. 
```

## drivers/PriChain_codes/rb_rwmutex/Kconfig
```kconfig
config RB_RWMUTEX
	tristate "RB Read-Write Mutex Support"
	depends on MODULES
	help
	  This enables support for RB Read-Write Mutex, a custom read-write
	  mutex implementation that can be used as an alternative to rwlock.
	  
	  If you want to compile it as a module, say M here.
	  If you want to compile it into the kernel, say Y here.
	  If you don't want to compile it, say N here.
	  
	  If unsure, say N. 
```

## drivers/PriChain_codes/rb_rwsem/Kconfig
```kconfig
config RB_RWSEM
	tristate "RB Read-Write Semaphore Support"
	depends on MODULES
	help
	  This enables support for RB Read-Write Semaphore, a custom read-write
	  semaphore implementation that can be used as an alternative to rwsem.
	  
	  If you want to compile it as a module, say M here.
	  If you want to compile it into the kernel, say Y here.
	  If you don't want to compile it, say N here.
	  
	  If unsure, say N. 
```
