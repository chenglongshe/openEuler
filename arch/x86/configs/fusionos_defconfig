## drivers/Kconfig
```kconfig
# 在最后追加以下代码

menu "RB Lock/Semaphore Support"
	depends on MODULES

source "drivers/PriChain_codes/rb_mutex/Kconfig"

source "drivers/PriChain_codes/rb_rwmutex/Kconfig"

source "drivers/PriChain_codes/rb_rwsem/Kconfig"

endmenu
```

## drivers/crypto/sedriver/Kconfig
```kconfig
#
# se chip configuration
#
config SW_SE_CHIP
	tristate "wst se chip driver"
	depends on LOONGARCH
	help
		If unsure, say N.
```

## drivers/hpf/Kconfig
```kconfig
config CONFIG_DINGHAI_HPF
    tristate "Dinghai DH_HPF Support"
    default m
    help
      Dinghai HPF for DPU.
```

## drivers/infiniband/hw/zrdma/Kconfig
```kconfig
# SPDX-License-Identifier: GPL-2.0

config INFINIBAND_ZRDMA
	tristate "ZTE Ethernet Protocol Driver for RDMA"
    depends on NET
 	select GENERIC_ALLOCATOR
 	select CONFIG_AUXILIARY_BUS
	help
	  Say Y or M here to enable support for the ZXDH ZRDMA RDMA device driver.

	  If you choose to build this driver as a module, it will be built as
	  a module named zrdma.
```

## drivers/net/ethernet/dinghai/Kconfig
```kconfig
config NET_VENDOR_DINGHAI
    tristate "Dinghai Devices"
    default y
    help
      If you have a Ethernet DINGHAI device belonging to this
	  class, say y.

if NET_VENDOR_DINGHAI

config DINGHAI_DH_CMD
    tristate "Dinghai DH_CMD Support"
    default m
    help
      Command interface for Dinghai devices.

config DINGHAI_EN_AUX
    tristate "Dinghai Auxiliary Support"
    default y
    help
      Auxiliary functionality for Dinghai devices.

config DINGHAI_NP
    tristate "Dinghai NP Support"
    default m
    depends on DINGHAI_DH_CMD
    help
      Network Processor (NP) support. Requires DINGHAI_DH_CMD.

config DINGHAI_PTP
    tristate "Dinghai PTP Support"
    default m
    depends on DINGHAI_DH_CMD && PTP_1588_CLOCK
    help
      Precision Time Protocol (PTP) support. Requires DINGHAI_DH_CMD and PTP_1588_CLOCK.

config DINGHAI_TSN
    bool "Dinghai Support TSN Macro"
    default y
    help
      Enable TSN-related compile-time macros.

config DINGHAI_TSN_M
    tristate "Dinghai TSN Module Support"
    default m
    help
      TSN runtime module support.

config ZXDH_SF
    tristate "Dinghai SF Support"
    default y
    help
      Sub-Function (SF) support.

config ZXDH_MSGQ
    tristate "Dinghai MSGQ Support"
    default m
    help
      Message queue support.

config DINGHAI_SEC
    tristate "Dinghai SEC Support"
    default n
    help
      Security (SEC) module support.

config DINGHAI_AUXILIARY
       tristate "Dinghai AUXILIARY Support"
       default m
       help
         Enable Dinghai AUXILIARY module Support

# Main PF driver
config DINGHAI_PF
    tristate "Dinghai PF Support"
    default m
    depends on DINGHAI_DH_CMD
    depends on DINGHAI_AUXILIARY
    depends on DINGHAI_NP
    depends on DINGHAI_PTP
    depends on DINGHAI_TSN_M
    help
      Primary Function (PF) driver for Dinghai devices.
      This driver requires CMD, Auxiliary, NP, PTP, and TSN modules.
      Note: PTP also requires PTP_1588_CLOCK to be enabled.

endif # NET_VENDOR_DINGHAI
```

## drivers/remote_pager/Kconfig
```kconfig
# SPDX-License-Identifier: GPL-2.0

menu "remote pager device"

config REMOTE_PAGER
	tristate "remote pager"
	default m
	depends on GMEM
	help
		Module used for gmem.
		This is comm part, including send and recv message function
		Used for memory management
		If unsure, say Y.

config REMOTE_PAGER_MASTER
	tristate "remote pager master"
	default m
	depends on REMOTE_PAGER
	help
		Module used for gmem.
		This is host part, used for send and recv message from device
		Used for memory management
		If unsure, say Y.

endmenu
```

## drivers/ub/Kconfig
```kconfig
# SPDX-License-Identifier: GPL-2.0+
#
# UnifiedBus configuration
#

source "drivers/ub/ubus/Kconfig"
source "drivers/ub/ubfi/Kconfig"
source "drivers/ub/ubase/Kconfig"
menuconfig UB
	tristate "Unified Bus (UB) core support"
	depends on ARM64 || X86_64
	default n
	help
	  Core support for Unified Bus (UB).
	  If you have a hardware that support ub protocol,
	  Say m here. By Default this option is closed.
	  To compile UB core as module, choose M here.

if UB

config UB_URMA
	tristate "Unified Bus (UB) urma support"
	default m
	help
	  Unified remote memory access(URMA) support. This
	  is the kernel side of the userspace urma support, which allows
	  userspace processes to send and receive urma cmd. You will also
	  need liburma from umdk
	  <https://gitee.com/openeuler/umdk>.

endif # UB
```

## ipc/Kconfig
```kconfig
config FAST_IPC
    tristate "Fast IPC support"
    default n
    help
       Fast Inter-process call, used to switch threads quickly.
```

## kernel/xsched/Kconfig
```kconfig
# SPDX-License-Identifier: GPL-2.0

config XCU_SCHEDULER
    bool "Enable XSched functionality"
    select CGROUP_XCU
    default n
    help
      This option enables the XSched scheduler, a custom scheduling mechanism
      designed for heterogeneous compute units (e.g., XPUs). It provides:
      - Priority-based task scheduling with latency-sensitive optimizations.
      - Integration with cgroups (via CGROUP_XCU) for resource isolation.

      Enable this only if your system requires advanced scheduling for XPU workloads.
      If unsure, say N.

config XCU_VSTREAM
    bool "Enable vstream SQ/CQ buffers maintaining for XPU"
    default n
    depends on XCU_SCHEDULER
    help
      This option enables virtual stream (vstream) support for XPUs, managing
      submission queues (SQ) and completion queues (CQ) in kernel space. Key features:
      - Zero-copy buffer management between user and kernel space.
      - Batch processing of XPU commands to reduce MMIO overhead.

      Requires XCU_SCHEDULER to be enabled. May increase kernel memory usage.
      Recommended for high-throughput XPU workloads. If unsure, say N.

config XSCHED_NR_CUS
    int "Number of CUs (a.k.a. XCUs) available to XSched mechanism"
    default 8
    depends on XCU_SCHEDULER
    help
      This option defines the maximum number of Compute Units (CUs) that can be
      managed by the XSched scheduler, consider changing this value proportionally
      to the number of available XCU cores.

config CGROUP_XCU
    bool "XCU bandwidth control and group scheduling for xsched_cfs"
    default n
    depends on XCU_SCHEDULER
    help
      This option enables the extended Compute Unit (XCU) resource controller for
      CFS task groups, providing hierarchical scheduling and fine-grained bandwidth
      allocation capabilities. Key features include:
      - Proportional XCU time distribution across cgroups based on shares/quotas
      - Nested group scheduling with latency isolation
      - Integration with xsched_cfs for fair CPU resource management

      Required for systems requiring fine-grained resource control in cgroups.
      If unsure, say N.
```
